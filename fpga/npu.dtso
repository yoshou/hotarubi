/dts-v1/;
/plugin/;

/ {
	fragment@0 {
		target = <&fpga_full>;
		__overlay__ {
			#address-cells = <2>;
			#size-cells = <2>;
			firmware-name = "npu.bit.bin";
			resets = <&zynqmp_reset 116>, <&zynqmp_reset 117>, <&zynqmp_reset 118>, <&zynqmp_reset 119>;
		};
	};

	fragment@1 {
		target = <&amba>;
		__overlay__ {
			#address-cells = <2>;
			#size-cells = <2>;

			npu_clk: clocking0 {
				compatible = "xlnx,fclk";
				#clock-cells = <0>;
				clocks = <&zynqmp_clk 71>;
				assigned-clocks = <&zynqmp_clk 71>;
				assigned-clock-rates = <250000000>;
				clock-output-names = "npu_clk";
			};

			npu@a0000000 {
				compatible = "generic-uio";
				reg = <0x0 0xa0000000 0x0 0x1000>;
				clocks = <&zynqmp_clk 71>;
				interrupt-parent = <&gic>;
				interrupts = <0 89 4>;
			};
		};
	};
};
